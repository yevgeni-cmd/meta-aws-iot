## meta-aws-iot/conf/distro/include/versions.inc
```bitbake
# Define package versions for arp-scan
ARP_SCAN_VERSION = "1.10.0"
# Define package versions for greengrass lite
GREENGRASS_LITE_VERSION = "2.0.2"
# Define package versions iot sdk
AWS_IOT_SDK_VERSION = "1.22.0"
```

## meta-aws-iot/conf/layer.conf
```bitbake
# We have a conf and classes directory, add to BBPATH
BBPATH .= ":${LAYERDIR}"

# We have recipes-* directories, add to BBFILES
BBFILES += "${LAYERDIR}/recipes-*/*/*.bb \
            ${LAYERDIR}/recipes-*/*/*.bbappend"

# this is necessary to find aws-aws-iot
BBFILES += "${LAYERDIR}/recipes-*/*/*/*.bb \
            ${LAYERDIR}/recipes-*/*/*/*.bbappend"

BBFILE_COLLECTIONS += "aws-aws-iot"
BBFILE_PATTERN_aws-aws-iot := "^${LAYERDIR}/"
BBFILE_PRIORITY_aws-aws-iot = "99"

# This should only be incremented on significant changes that will
# cause compatibility issues with other layers
LAYERVERSION_aws-aws-iot = "1"
LAYERSERIES_COMPAT_aws-aws-iot = "scarthgap"
LAYERDEPENDS_aws-aws-iot = "core meta-aws"

# Ignore aws-iot-greengrass-lite-container-demo-image.bb that requires meta-virtualization if it's not present.
BBMASK += "${@bb.utils.contains('BBFILE_COLLECTIONS', 'virtualization-layer', '', 'aws-aws-iot/recipes-core/images/aws-iot-greengrass-lite-container-demo-image/aws-iot-greengrass-lite-container-demo-image*', d)}"

# Ignore other images than the selected IMAGE, this is necessary if an image use a layer global class that is not present in other images it will give error otherwise.
BBMASK += "/aws-aws-iot/recipes-core/images/(?!${IMAGE}/)"
```
